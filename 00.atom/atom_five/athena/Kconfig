## 00.atom/atom_five/athena/atom_light/Kconfig
```kconfig
config CPJ_ATOM_LIGHT
  bool CONFIG_CPJ_ATOM_LIGHT
  default y
  help
    CONFIG_CPJ_ATOM_LIGHT
```

## 00.atom/atom_irq/fingerbutton/Kconfig
```kconfig
config DEWAV_FINGERBUTTON
	bool "DEWAV_FINGERBUTTON"
	help
		Support Dewav FingerButton
```

## 00.atom/lcm_info/Kconfig
```kconfig
#
# lcm_info subsystem configuration
#

config LCMINFO
    tristate "Lcm_info Operation in kernel support" 
    default y
    help
        LCMINFO is a kernel module that used to get lcm info.
```
